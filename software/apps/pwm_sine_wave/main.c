#include <math.h>

#include "pico/stdlib.h"
#include "hardware/pwm.h"
#include "hardware/vreg.h"
#include "hardware/irq.h"

#define CORE_VOLTAGE VREG_VOLTAGE_1_20
#define SYS_CLOCK_KHZ 252000
#define SAMPLE_CLOCK_KHZ 48
#define SAMPLE_BITS 12

static_assert(SYS_CLOCK_KHZ % SAMPLE_CLOCK_KHZ == 0, "Audio clock must divide system clock");
static_assert(1 << SAMPLE_BITS < SYS_CLOCK_KHZ / SAMPLE_CLOCK_KHZ, "Samples larger than PWM period");
static_assert(1 << SAMPLE_BITS >= SYS_CLOCK_KHZ / SAMPLE_CLOCK_KHZ / 2, "Samples less than half of PWM period");

// Range 0 to 0xfff
static uint16_t __time_critical_func(sine_table)[256] = {
	0x800,  0x832,  0x864,  0x896,  0x8c8,  0x8fa,  0x92c,  0x95e,  0x98f,  0x9c0,
	0x9f1,  0xa22,  0xa52,  0xa82,  0xab1,  0xae1,  0xb0f,  0xb3d,  0xb6b,
	0xb98,  0xbc5,  0xbf1,  0xc1c,  0xc47,  0xc71,  0xc9b,  0xcc3,  0xceb,  0xd13,
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	0x63f,  0x670,  0x6a1,  0x6d3,  0x705,  0x737,  0x769,  0x79b,  0x7cd
};

#define C4 261.63f
#define D4 293.66f
#define E4 329.63f
#define F4 349.23f
#define G4 392.00f
#define A4 440.00f
#define B4 493.88f

const struct {float freq_hz; uint duration_ms;} song[] = {
	{C4    , 500 },
	{D4    , 500 },
	{E4    , 500 },
	{F4    , 500 },
	{G4    , 500 },
	{A4    , 500 },
	{B4    , 500 },
	{C4 * 2, 500 },
	{0     , 1000},
};

static inline void pwm_set_both_channels(uint slice, uint16_t sample) {
	// 16 bit data gets replicated to 32 bits on the bus
	*(io_rw_16*)&pwm_hw->slice[slice].cc = sample;
}

uint audio_pwm_slice;
float note_freq_hz = 440;

void pwm_irq_handler() {
	pwm_clear_irq(audio_pwm_slice);

	// Let Pi = 128 :)
	static float theta = 0;
	theta += note_freq_hz * (256.f / (SAMPLE_CLOCK_KHZ * 1000));
	if (theta >= 256.f)
		theta -= 256.f;

	pwm_set_both_channels(audio_pwm_slice, sine_table[(uint8_t)theta]);
}


int main() {
	vreg_set_voltage(CORE_VOLTAGE);
	sleep_ms(1);
	set_sys_clock_khz(SYS_CLOCK_KHZ, true);

	audio_pwm_slice = pwm_gpio_to_slice_num(PICOSTATION_AUDIO_PWM_R_PIN);
	pwm_config c = pwm_get_default_config();
	pwm_config_set_wrap(&c, SYS_CLOCK_KHZ / SAMPLE_CLOCK_KHZ - 1);
	pwm_init(audio_pwm_slice, &c, false);
	pwm_set_both_channels(audio_pwm_slice, 1u << (SAMPLE_BITS - 1));

	pwm_clear_irq(audio_pwm_slice);
	pwm_set_irq_enabled(audio_pwm_slice, true);
	irq_set_exclusive_handler(PWM_IRQ_WRAP, pwm_irq_handler);


	gpio_set_function(PICOSTATION_AUDIO_PWM_R_PIN, GPIO_FUNC_PWM);
	pwm_set_enabled(audio_pwm_slice, true);
	irq_set_enabled(PWM_IRQ_WRAP, true);
	while (true) {
		for (int note = 0; note < count_of(song); ++note) {
			note_freq_hz = song[note].freq_hz;
			sleep_ms(song[note].duration_ms);
		}
	}
}
